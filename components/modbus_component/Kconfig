## components/modbus_component/Kconfig
```kconfig
menuconfig MODBUS_ENABLED
    bool "Enable libmodbus"
    default n

    config MODBUS_DYNAMIC
        bool "compile component as dynamic(shared) lib"
        default n
        depends on MODBUS_ENABLED
```

## components/mongoose/Kconfig
```kconfig
menuconfig MONGOOSE_ENABLED
    bool "Enable mongoose"
    default n

    config MONGOOSE_DYNAMIC
        bool "compile component as dynamic(shared) lib"
        default n
        depends on MONGOOSE_ENABLED
```

## components/nanojpeg/Kconfig
```kconfig
menuconfig NANOJPEG_ENABLED
    bool "Enable nanojpeg"
    default n

    config NANOJPEG_DYNAMIC
        bool "compile component as dynamic(shared) lib"
        default n
        depends on NANOJPEG_ENABLED
```

## components/nanolog/Kconfig
```kconfig
menuconfig NANO_LOG_ENABLED
    bool "nano_log configuration"
    default n

    config NANO_LOG_DYNAMIC
        bool "compile component as dynamic(shared) lib"
        default n
        depends on NANO_LOG_ENABLED
        help
            Enable include static lib(from gcc)
```

## components/nanomsg/Kconfig
```kconfig
menuconfig NANOMSG_ENABLED
    bool "Enable nanomsg"
    default n

    config NANOMSG_DYNAMIC
        bool "compile component as dynamic(shared) lib"
        default n
        depends on NANOMSG_ENABLED
```

## components/ncnn/Kconfig
```kconfig
menuconfig NCNN_ENABLED
    bool "Enable libncnn"
    default n

    config NCNN_ARM_LINUX_GNUEABIHF
        bool "build on arm-linux-gnueabihf"
        default y
        depends on NCNN_ENABLED

    config NCNN_DYNAMIC
        bool "compile component as dynamic(shared) lib"
        default n
        depends on NCNN_ENABLED
```

## components/nng/Kconfig
```kconfig
menuconfig LNNG_ENABLED
    bool "Enable nng"
    default n

    config NNG_HAVE_BUS0
        bool "compile bus0"
        default y
        depends on LNNG_ENABLED

    config NNG_HAVE_PAIR0
        bool "compile pair0"
        default y
        depends on LNNG_ENABLED

    config NNG_HAVE_PAIR1
        bool "compile pair1"
        default y
        depends on LNNG_ENABLED

    config NNG_HAVE_SURVEYOR0
        bool "compile surveyor0"
        default y
        depends on LNNG_ENABLED

    config NNG_HAVE_PUBSUB0
        bool "compile pubsub0"
        default y
        depends on LNNG_ENABLED

    config NNG_HAVE_PULLPUSH0
        bool "compile pullpush0"
        default y
        depends on LNNG_ENABLED

    config NNG_HAVE_REPREQ0
        bool "compile repreq"
        default y
        depends on LNNG_ENABLED

    config NNG_TRANSPORT_FDC
        bool "compile fdc"
        default n
        depends on LNNG_ENABLED

    config NNG_TRANSPORT_INPROC
        bool "compile inproc"
        default y
        depends on LNNG_ENABLED

    config NNG_TRANSPORT_IPC
        bool "compile ipc"
        default y
        depends on LNNG_ENABLED

    config NNG_TRANSPORT_TCP
        bool "compile tcp"
        default y
        depends on LNNG_ENABLED

    config NNG_TRANSPORT_TLS
        bool "compile tls"
        default n
        depends on LNNG_ENABLED

        choice
            prompt "choice TLS engine"
            default TLS_MBEDTLS_ENABLED
            depends on NNG_TRANSPORT_TLS
        config TLS_MBEDTLS_ENABLED
            bool "enable mbedtls"
        config TLS_WOLFSSL_ENABLED
            bool "enable wolfssl"
        endchoice

    config NNG_TRANSPORT_UDP
        bool "compile udp"
        default y
        depends on LNNG_ENABLED

    config NNG_TRANSPORT_WS
        bool "compile ws"
        default n
        depends on LNNG_ENABLED

    config NNG_SUPP_HTTP
        bool "compile http"
        default n
        depends on LNNG_ENABLED

    config NNG_MAX_EXPIRE_THREADS
        int "nng max expire threads"
        default 2
        depends on LNNG_ENABLED

    config NNG_MAX_POLLER_THREADS
        int "nng max poller threads"
        default 2
        depends on LNNG_ENABLED

    config NNG_MAX_TASKQ_THREADS
        int "nng max taskq threads"
        default 4
        depends on LNNG_ENABLED

    config NNG_ENABLE_IPV6
        bool "enable ipv6"
        default y
        depends on LNNG_ENABLED

    config LNNG_DYNAMIC
        bool "compile component as dynamic(shared) lib"
        default n
        depends on LNNG_ENABLED
```

## components/qrencode_component/Kconfig
```kconfig
menuconfig QRENCODE_COMPONENT_ENABLED
    bool "Enable qrencode_component"
    default n
    config QRENCODE_COMPONENT_DYNAMIC
        bool "compile component as dynamic(shared) lib"
        default n
        depends on QRENCODE_COMPONENT_ENABLED
```

## components/simdjson_component/Kconfig
```kconfig
menuconfig SIMDJSON_COMPENENT_ENABLED
    bool "Enable simdjson"
    default n

    config SIMDJSON_COMPENENT_DYNAMIC
        bool "compile component as dynamic(shared) lib"
        default n
        depends on SIMDJSON_COMPENENT_ENABLED
```

## components/simpleini/Kconfig
```kconfig
menuconfig SIMPLEINI_ENABLED
    bool "Enable simpleini"
    default n

    config SIMPLEINI_DYNAMIC
        bool "compile simpleini as dynamic(shared) lib"
        default n
        depends on SIMPLEINI_ENABLED
```

## components/single_header_libs/Kconfig
```kconfig
menuconfig SINGLE_HEADER_LIBS_ENABLED
    bool "Enable single_header_libs"
    default n

    config SINGLE_HEADER_LIBS_DYNAMIC
        bool "compile component as dynamic(shared) lib"
        default n
        depends on SINGLE_HEADER_LIBS_ENABLED
```

## components/sqlite3_component/Kconfig
```kconfig
menuconfig SQLITE3_COMPOENENT_ENABLED
    bool "Enable sqlite3 lib"
    default n

    config SQLITE3_COMPOENENT_DYNAMIC
        bool "compile component as dynamic(shared) lib"
        default n
        depends on SQLITE3_COMPOENENT_ENABLED
```

## components/static_package/Kconfig
```kconfig
menuconfig STATIC_PACKAGE_ENABLED
    bool "static_package configuration"
    default n

    menuconfig OPENCV_LIB_ENABLED
        bool "opencv lib"
        default n
        depends on STATIC_PACKAGE_ENABLED
        help
            include opencv lib(from gcc)

        choice
            prompt "opencv versions"
            default OPENCV_LIB_NCNN_ENABLED
            depends on OPENCV_LIB_ENABLED
        config OPENCV_LIB_AXERA_ENABLED
            bool "include opencv-arm-linux lib"
            help
                build by AXERA!
        config OPENCV_LIB_NCNN_ENABLED
            bool "include opencv-mobile-2.4.13.7-armlinux lib"
            help
                build by NCNN!
        endchoice
```

## components/tinyalsa_component/Kconfig
```kconfig
menuconfig TINYALSA_COMPONENT_ENABLED
    bool "Enable tinyalsa_component"
    default n

    config TINYALSA_COMPONENT_DYNAMIC
        bool "compile component as dynamic(shared) lib"
        default n
        depends on TINYALSA_COMPONENT_ENABLED
```

## components/tinyjpeg/Kconfig
```kconfig
menuconfig TINY_JPEG_ENABLED
    bool "Enable tiny_jpeg"
    default n

    config TINY_JPEG_DYNAMIC
        bool "compile component as dynamic(shared) lib"
        default n
        depends on TINY_JPEG_ENABLED
```

## components/tommath/Kconfig
```kconfig
menuconfig TOMMATH_ENABLED
    bool "Enable libtommath"
    default n

    config TOMMATH_DYNAMIC
        bool "compile component as dynamic(shared) lib"
        default n
        depends on TOMMATH_ENABLED
```

## components/toolkit/Kconfig
```kconfig
menuconfig TOOLKIT_ENABLED
    bool "Enable toolkit"
    default n

    config TOOLKIT_DYNAMIC
        bool "compile component as dynamic(shared) lib"
        default n
        depends on TOOLKIT_ENABLED
```

## components/u8g2_component/Kconfig
```kconfig
menuconfig U8G2_COMPONENT_ENABLED
    bool "Enable u8g2"
    default n

	config U8G2_COMPONENT_CXX
		bool "compile u8g2 with c"
		default y
		depends on U8G2_COMPONENT_ENABLED

	config U8G2_COMPONENT_CPP
		bool "compile u8g2 with cpp"
		default n
		depends on U8G2_COMPONENT_ENABLED


    config U8G2_COMPONENT_DYNAMIC
        bool "compile component as dynamic(shared) lib"
        default n
        depends on U8G2_COMPONENT_ENABLED
```

## components/unitv2_support/Kconfig
```kconfig
menuconfig UNITV2_SUPPORT_ENABLED
    bool "Enable unitv2_boad_support"
    default n

    config UNITV2_NCNN_ENABLED
        bool "Enable unitv2 ncnn"
        default n
        depends on UNITV2_SUPPORT_ENABLED
```

## components/utilities/Kconfig
```kconfig
menuconfig UTILITIES_ENABLED
    bool "Enable threerDparty utilities"
    default n

    config UTILITIES_FMT_ENABLED
        bool "compile fmt lib"
        default n
        depends on UTILITIES_ENABLED

    config UTILITIES_EASYMSGCPP_ENABLED
        bool "compile easy-msg-cpp lib"
        default n
        depends on UTILITIES_ENABLED

    config UTILITIES_BASE64_ENABLED
        bool "compile base64 lib"
        default n
        depends on UTILITIES_ENABLED

    config UTILITIES_INI_ENABLED
        bool "compile ini lib"
        default n
        depends on UTILITIES_ENABLED

    config UTILITIES_DYNAMIC
        bool "compile threerDparty as dynamic(shared) lib"
        default n
        depends on UTILITIES_ENABLED
```

## components/zpl/Kconfig
```kconfig
menuconfig ZPL_ENABLED
    bool "Enable libzpl"
    default n

    config ZPL_DYNAMIC
        bool "compile component as dynamic(shared) lib"
        default n
        depends on ZPL_ENABLED
```

## github_source/minicv2/Kconfig
```kconfig
config COMPONENT_IMLIB_ENABLE
    bool "Enable imlib component"
    default y
    help
        Select this option to enable use imlib.
```
