/dts-v1/;
/plugin/;

&spi4 {
	pinctrl-names = "default", "sleep";
	pinctrl-0 = <&spi4_pins_mx>;
	pinctrl-1 = <&spi4_sleep_pins_mx>;
	cs-gpios = <&gpioc 13 1>; // <&gpioc 13 GPIO_ACTIVE_LOW>

	/delete-property/dmas;
	/delete-property/dma-names;
	status = "okay";

	spidev@0 {
		compatible = "rohm,dh2228fv";
		reg = <0>;
		spi-max-frequency = <1000000>;
	};
};