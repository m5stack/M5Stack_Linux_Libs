## Kconfig
```kconfig
mainmenu "C/CPP CMake project framework Kconfig configuration"

menu "Toolchain configuration"
	config TOOLCHAIN_PATH
		string "toolchain path"
		default ""

	config TOOLCHAIN_PREFIX
		string "toolchain prefix"
		default ""

	config TOOLCHAIN_FLAGS
		string "toolchain FLAGS"
		default ""

	config LIB_LINK_SEARCH_PATH
		string "lib link search patch"
		default ""

	choice
		prompt "host system type"
		default TOOLCHAIN_SYSTEM_UNIX
	config TOOLCHAIN_SYSTEM_UNIX
		bool "unix"
	config TOOLCHAIN_SYSTEM_WIN
		bool "win"
	endchoice

	config REPO_AUTOMATION
		bool 'Download automation for the repo.'
		default n

	config COMMPILE_DEBUG
		bool 'commpile debug msg!'
		default n
endmenu

menu "Components configuration"
	osource "${SDK_PATH}/components/*/Kconfig"
	osource "${PROJECT_PATH}/../components/*/Kconfig"
	osource "${PROJECT_PATH}/*/Kconfig"
endmenu

config USE_STRIP_REDUCE_SIZE_ENABLED
	bool "strip reduce size"
	default n
```

## components/Backward_cpp/Kconfig
```kconfig
menuconfig BACKWARD_CPP_ENABLED
    bool "Enable Backward_cpp"
    default n

    config BACKWARD_CPP_DYNAMIC
        bool "compile component as dynamic(shared) lib"
        default n
        depends on BACKWARD_CPP_ENABLED
```

## components/Cimg/Kconfig
```kconfig
menuconfig CIMG_COMPONENT_ENABLED
    bool "Enable Cimg"
    default n

    config CIMG_COMPONENT_DYNAMIC
        bool "compile component as dynamic(shared) lib"
        default n
        depends on CIMG_COMPONENT_ENABLED
```

## components/DeviceDriver/Kconfig
```kconfig
menuconfig DEVICE_DRIVER_ENABLED
    bool "Enable DeviceDriver"
    default n

	config M5DEVICE_SH1107
		bool "compile sh1107 driver"
		default n
		depends on DEVICE_DRIVER_ENABLED

    config DEVICE_UART_ENABLED
        bool "compile uart lib"
        default n
        depends on DEVICE_DRIVER_ENABLED

    config DEVICE_I2C_ENABLED
        bool "compile i2c lib"
        default n
        depends on DEVICE_DRIVER_ENABLED

    config DEVICE_SPI_ENABLED
        bool "compile spi lib"
        default n
        depends on DEVICE_DRIVER_ENABLED

    config DEVICE_FRAMEBUFFER_ENABLED
        bool "compile framebuffer lib"
        default n
        depends on DEVICE_DRIVER_ENABLED

    config DEVICE_PTMX_ENABLED
        bool "compile ptmx lib"
        default n
        depends on DEVICE_DRIVER_ENABLED

    config DEVICE_DRIVER_DYNAMIC
        bool "compile component as dynamic(shared) lib"
        default n
        depends on DEVICE_DRIVER_ENABLED
```

## components/LovyanGFX/Kconfig
```kconfig
menuconfig LOVYANGFX_ENABLED
    bool "Enable LovyanGFX"
    default n

    config LOVYANGFX_DYNAMIC
        bool "compile component as dynamic(shared) lib"
        default n
        depends on LOVYANGFX_ENABLED
```

## components/SOEM/Kconfig
```kconfig
menuconfig SOEM_ENABLED
    bool "Enable soem"
    default n

    config SOEM_DYNAMIC
        bool "compile component as dynamic(shared) lib"
        default n
        depends on SOEM_ENABLED
```

## components/anyany/Kconfig
```kconfig
menuconfig ANYANY_ENABLED
    bool "Enable anyany"
    default n
    config ANYANY_SRC_ENABLED
        bool "Enable any src"
        default n
		depends on ANYANY_ENABLED

    config ANYANY_DYNAMIC
        bool "compile component as dynamic(shared) lib"
        default n
        depends on ANYANY_ENABLED
```

## components/ax620u_support/Kconfig
```kconfig
menuconfig UNITV3_SUPPORT_ENABLED
    bool "Enable unitv3_boad_support"
    default n

    config UNITV3_OPENCV_ENABLED
        bool "compile opencv lib"
        default y
        depends on UNITV3_SUPPORT_ENABLED


    config UNITV3_BSP_SUPPORT_ENABLED
        bool "Enable unitv3 bsp"
        default n
        depends on UNITV3_SUPPORT_ENABLED

    menuconfig UNITV3_AX_SAMPLES_LIB_ENABLED
        bool "Enable ax-samples-libs"
        default n
        depends on UNITV3_SUPPORT_ENABLED

        config UNITV3_AX_SAMPLES_LIB_DYNAMIC
            bool "compile as dynamic(shared) lib"
            default n
            depends on UNITV3_AX_SAMPLES_LIB_ENABLED

    
    menuconfig UNITV3_AX_PIPELINE_LIB_ENABLED
        bool "Enable ax-pipeline"
        default n
        depends on UNITV3_SUPPORT_ENABLED


        config UNITV3_AX_PIPELINE_LIB_BYTETRACK_ENABLED
            bool "compile ByteTrack lib"
            default n
            depends on UNITV3_AX_PIPELINE_LIB_ENABLED

        config UNITV3_AX_PIPELINE_LIB_LIBV4L2CPP_ENABLED
            bool "compile libv4l2cpp lib"
            default n
            depends on UNITV3_AX_PIPELINE_LIB_ENABLED
        config UNITV3_AX_PIPELINE_LIB_LIBYUV_ENABLED
            bool "compile as libyuv lib"
            default n
            depends on UNITV3_AX_PIPELINE_LIB_ENABLED
        config UNITV3_AX_PIPELINE_LIB_MP4DEMUX_ENABLED
            bool "compile mp4demux lib"
            default n
            depends on UNITV3_AX_PIPELINE_LIB_ENABLED
        config UNITV3_AX_PIPELINE_LIB_RTSP_ENABLED
            bool "compile RTSP lib"
            default n
            depends on UNITV3_AX_PIPELINE_LIB_ENABLED
        config UNITV3_AX_PIPELINE_LIB_RTSPSERVER_ENABLED
            bool "compile RtspServer lib"
            default n
            depends on UNITV3_AX_PIPELINE_LIB_ENABLED

    config UNITV3_AI_COMMON_ENABLED
        bool "Enable ai_common"
        default n
        depends on UNITV3_SUPPORT_ENABLED
```

## components/axcl_msp/Kconfig
```kconfig
menuconfig AXCL_MSP_ENABLED
    bool "Enable axcl_msp support"
    default n
    help
        enable axera axcl bsp support

    choice
        prompt "choice board"
        default AX_8850_MSP_ENABLED
        depends on AXCL_MSP_ENABLED
    config AX_650_MSP_ENABLED
        bool "enable ax650 bsp"
        help
            build by AXERA!
    config AX_8850_MSP_ENABLED
        bool "enable ax8850 bsp"
        help
            build by AXERA!
    endchoice
    
    choice
        prompt "choice common version"
        default MSP_V3_6_2_ENABLED
        depends on AXCL_MSP_ENABLED
    config MSP_V3_6_2_ENABLED
        bool "enable v3.6.2 bsp"
        help
            build by m5stack!
    config MSP_V3_6_4_ENABLED
        bool "enable v3.6.4 bsp"
        help
            build by m5stack!
    config MSP_V3_0_2_ENABLED
        bool "enable v3.0.2 bsp"
        help
            build by m5stack!
    endchoice
```

## components/axera_support/Kconfig
```kconfig
menuconfig AXERA_SUPPORT_ENABLED
    bool "Enable axera_boad_support"
    default n

    config AX620U_SUPPORT_ENABLED
        bool "Enable ax620u bsp"
        default n
        depends on AXERA_SUPPORT_ENABLED

    config AX620Q_SUPPORT_ENABLED
        bool "Enable ax620q bsp"
        default n
        depends on AXERA_SUPPORT_ENABLED


    config AXERA_AI_COMMON_ENABLED
        bool "Enable ai_common"
        default n
        depends on AXERA_SUPPORT_ENABLED
```

## components/c_periphery/Kconfig
```kconfig
menuconfig C_PERIPHERY_COMPONENT_ENABLED
    bool "Enable c_periphery"
    default n

    config C_PERIPHERY_COMPONENT_DYNAMIC
        bool "compile component as dynamic(shared) lib"
        default n
        depends on C_PERIPHERY_COMPONENT_ENABLED
```

## components/component1/Kconfig
```kconfig
menuconfig COMPONENT1_ENABLED
    bool "Component1 configuration"
    default n

    config COMPONENT1_DYNAMIC
        bool "compile component as dynamic(shared) lib"
        default n
        depends on COMPONENT1_ENABLED
        help
            Enable include static lib(from gcc)
```

## components/deprecated/Kconfig
```kconfig
menu "Deprecated Components configuration"
    osource "${SDK_PATH}/components/deprecated/*/Kconfig"
    osource "${PROJECT_PATH}/../components/deprecated/*/Kconfig"
endmenu
```

## components/deprecated/gear_libs/Kconfig
```kconfig
menuconfig GEAR_LIBS_ENABLED
    bool "Enable gear-lib"
    default n


    config GEAR_LIBS_POSIX_ENABLED
        bool "compile gear-lib posix lib"
        default n
        depends on GEAR_LIBS_ENABLED


    config GEAR_LIBS_LOG_ENABLED
        bool "compile gear-lib log lib"
        default n
        depends on GEAR_LIBS_ENABLED && GEAR_LIBS_POSIX_ENABLED

    config GEAR_LIBS_COLLECTIONS_ENABLED
        bool "Enable libcollections"
        default n
        depends on GEAR_LIBS_ENABLED && GEAR_LIBS_POSIX_ENABLED




    config GEAR_LIBS_DYNAMIC
        bool "compile component as dynamic(shared) lib"
        default n
        depends on GEAR_LIBS_ENABLED
```

## components/deprecated/m5gfx/Kconfig
```kconfig
menuconfig M5GFX_ENABLED
    bool "Enable M5GFX"
    default n

    config M5GFX_DYNAMIC
        bool "compile component as dynamic(shared) lib"
        default n
        depends on U8G2_COMPONENT_ENABLED
```

## components/ffmpeg_vcode/Kconfig
```kconfig
menuconfig FFMPEG_VCODE_ENABLED
    bool "ffmpeg_vcode configuration"
    default n

    config FFMPEG_VCODE_DYNAMIC
        bool "compile component as dynamic(shared) lib"
        default n
        depends on FFMPEG_VCODE_ENABLED
        help
            Enable include static lib(from gcc)
```

## components/freetype_component/Kconfig
```kconfig
menuconfig FREETYPE_ENABLED
    bool "Enable freetype_component"
    default n



    config FREETYPE_DYNAMIC
        bool "compile component as dynamic(shared) lib"
        default n
        depends on FREETYPE_ENABLED
```

## components/gpiod_component/Kconfig
```kconfig
menuconfig GPIOD_ENABLED
    bool "Enable libgpiod"
    default n

    config GPIOD_DYNAMIC
        bool "compile component as dynamic(shared) lib"
        default n
        depends on GPIOD_ENABLED
```

## components/hv/Kconfig
```kconfig
menuconfig LHV_ENABLED
    bool "Enable lhv"
    default n

	config LHV_WITH_KCP
		bool "with kcp"
		default n
		depends on LHV_ENABLED

	config LHV_WITH_PROTOCOL
		bool "compile protocol"
		default n
		depends on LHV_ENABLED

	config LHV_WITH_EVPP
		bool "compile evpp"
		default n
		depends on LHV_ENABLED

		config LHV_WITH_HTTP
			bool "compile http"
			default n
			depends on LHV_WITH_EVPP

			config LHV_WITH_WITH_HTTP_CLIENT
				bool "compile http/client"
				default n
				depends on LHV_WITH_HTTP

			config LHV_WITH_HTTP_SERVER
				bool "compile http/server"
				default n
				depends on LHV_WITH_HTTP

	config LHV_WITH_MQTT
		bool "compile mqtt"
		default n
		depends on LHV_ENABLED

	config LHV_WITH_OPENSSL
		bool "with openssl library"
		default n
		depends on LHV_ENABLED

    config LHV_DYNAMIC
        bool "compile component as dynamic(shared) lib"
        default n
        depends on LHV_ENABLED
```

## components/lvgl_component/Kconfig
```kconfig
menuconfig LVGL_COMPONENT_ENABLED
    bool "Enable lvgl"
    default n

if LVGL_COMPONENT_ENABLED
    menu "lvgl version"
		choice
			prompt "choice lvgl version"
			default LVGL_9_0_SRC
		config LVGL_9_0_SRC
			bool "enable lvgl9.0"
			help
				build by LVGL!
		config LVGL_9_3_SRC
			bool "enable lvgl9.3"
			help
				build by LVGL!
		endchoice

    endmenu

if LVGL_9_3_SRC
	osource "${SDK_PATH}/components/lvgl_component/lvgl_9_3/Kconfig"
endif

endif
```

## components/mbedtls_component/Kconfig
```kconfig
menuconfig MBEDTLS_COMPONENT_ENABLED
    bool "Enable mbedtls component"
    default n

	config EVEREST_ENABLED
		bool "compile mbedtls libeverest"
		default n
		depends on MBEDTLS_COMPONENT_ENABLED

	config P256M_ENABLED
		bool "compile mbedtls libp256m"
		default n
		depends on MBEDTLS_COMPONENT_ENABLED

	config MBEDCRYPTO_ENABLED
		bool "compile mbedtls libmbedcrypto"
		default n
		depends on MBEDTLS_COMPONENT_ENABLED

	config MBEDX509_ENABLED
		bool "compile mbedtls libmbedx509"
		default n
		depends on MBEDTLS_COMPONENT_ENABLED

	config MBEDTLS_ENABLED
		bool "compile mbedtls libmbedtls"
		default n
		depends on MBEDTLS_COMPONENT_ENABLED
```

## components/minicv2/Kconfig
```kconfig
menuconfig MINICV2_COMPONENT_ENABLED
    bool "Enable minicv2"
    default n

    config MINICV2_COMPONENT_DYNAMIC
        bool "compile component as dynamic(shared) lib"
        default n
        depends on MINICV2_COMPONENT_ENABLED
```
